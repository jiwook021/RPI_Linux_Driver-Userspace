/dts-v1/;
/plugin/;
/ {
	compatible = "brcm,bcm2835";
	fragment@0 {
		target-path = "/";
		__overlay__ {
			haha_device {
				compatible = "brightlight,haha_device";
                reg = <0xFE200000 0x100>;
				status = "okay";
				label = "Test hahadev";
				haha_value = <48>;
			};
		};
	};
};