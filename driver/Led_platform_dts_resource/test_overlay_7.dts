/dts-v1/;
/plugin/;
/ {
	compatible = "brcm,bcm2835";
	fragment@0 {
		target-path = "/";
        #address-cells = <0x02>;
        #size-cells = <0x01>;
		__overlay__ {
			haha_device {
				compatible = "brightlight,haha_device";
                reg = <0xFE200000 0xFE200000 0x100 0xFE200100 0xFE200100 0x100>;
				status = "okay";
				label = "Test hahadev";
				haha_value = <48>;
			};
		};
	};
};